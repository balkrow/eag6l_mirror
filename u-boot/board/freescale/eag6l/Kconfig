## u-boot/board/freescale/eag6l/Kconfig
```kconfig
# SPDX-License-Identifier: GPL-2.0
if TARGET_EAG6L

config SYS_BOARD
	default "eag6l"

config SYS_VENDOR
	default "freescale"

config SYS_SOC
	default "ls102xa"

config SYS_CONFIG_NAME
	default "eag6l"

config HFR_USE_EMMC_FLASH
	bool
	default 1   

source "board/freescale/common/Kconfig"

endif
```

## u-boot/board/freescale/iugcpiuv2/Kconfig
```kconfig
# SPDX-License-Identifier: GPL-2.0
if TARGET_IUGCPIUV2

config SYS_BOARD
	default "iugcpiuv2"

config SYS_VENDOR
	default "freescale"

config SYS_SOC
	default "ls102xa"

config SYS_CONFIG_NAME
	default "iugcpiuv2"

config HFR_USE_EMMC_FLASH
	bool
	default 1   

source "board/freescale/common/Kconfig"

endif
```

## u-boot/configs/iugcpiuv2_sdcard_d4_secure_defconfig
```kconfig
CONFIG_ARM=y
CONFIG_TARGET_IUGCPIUV2=y
CONFIG_SYS_TEXT_BASE=0x82000000
CONFIG_SPL_LIBCOMMON_SUPPORT=y
CONFIG_SPL_LIBGENERIC_SUPPORT=y
CONFIG_SPL_MMC_SUPPORT=y
CONFIG_SPL_SERIAL_SUPPORT=y
CONFIG_NR_DRAM_BANKS=1
CONFIG_SPL=y
CONFIG_AHCI=y
CONFIG_SPL_TEXT_BASE=0x10000000
CONFIG_HUSH_PARSER=y
CONFIG_FIT=y
CONFIG_OF_BOARD_SETUP=y
CONFIG_OF_STDOUT_VIA_ALIAS=y
CONFIG_SYS_EXTRA_OPTIONS="RAMBOOT_PBL,SPL_FSL_PBL,SD_BOOT,SYS_FSL_DDR,SYS_FSL_DDR4"
CONFIG_BOOTDELAY=3
CONFIG_SILENT_CONSOLE=y
CONFIG_HFR_USE_EMMC_FLASH=y
CONFIG_SUPPORT_EMMC_BOOT=y
CONFIG_SUPPORT_EMMC_RPMB=y
CONFIG_MISC_INIT_R=y
CONFIG_SYS_MMCSD_RAW_MODE_U_BOOT_USE_SECTOR=y
CONFIG_SYS_MMCSD_RAW_MODE_U_BOOT_SECTOR=0xe8
CONFIG_SPL_ENV_SUPPORT=y
CONFIG_SPL_I2C_SUPPORT=y
CONFIG_SPL_MPC8XXX_INIT_DDR_SUPPORT=y
CONFIG_SPL_WATCHDOG_SUPPORT=y
CONFIG_CMD_GREPENV=y
CONFIG_CMD_MEMINFO=y
CONFIG_CMD_HFR=y
CONFIG_CMD_DM=y
CONFIG_CMD_GPT=y
CONFIG_CMD_I2C=y
CONFIG_CMD_MMC=y
CONFIG_CMD_MII=y
CONFIG_CMD_SF=y
CONFIG_CMD_PING=y
CONFIG_CMD_FS_UUID=y
CONFIG_CMD_EXT4=y
CONFIG_CMD_EXT4_WRITE=y
CONFIG_OF_CONTROL=y
CONFIG_DEFAULT_DEVICE_TREE="iugcpiuv2"
CONFIG_ENV_IS_IN_MMC=y
CONFIG_DM=y
CONFIG_FSL_CAAM=y
CONFIG_DM_MMC=y
CONFIG_FSL_ESDHC=y
CONFIG_DM_SPI_FLASH=y
CONFIG_SPI_FLASH=y
CONFIG_SPI_FLASH_ATMEL=y
CONFIG_SPI_FLASH_SPANSION=y
CONFIG_SPI_FLASH_STMICRO=y
CONFIG_SPI_FLASH_MACRONIX=y
CONFIG_SPI_FLASH_DATAFLASH=y
CONFIG_PHY_REALTEK=y
CONFIG_PHY_ICPLUS=y
CONFIG_PHY_FIXED=y
CONFIG_NET_RANDOM_ETHADDR=y
CONFIG_DM_ETH=y
CONFIG_DM_MDIO=y
CONFIG_PHY_GIGE=y
CONFIG_MII=y
CONFIG_TSEC_ENET=y
CONFIG_SYS_NS16550=y
```
